## config/boards/shields/orcus/Kconfig.defconfig
```kconfig
# Copyright (c) 2022 The ZMK Contributors
# SPDX-License-Identifier: MIT

if SHIELD_ORCUS_LEFT

config ZMK_KEYBOARD_NAME
    default "ORCUS"
    
config ZMK_SPLIT_ROLE_CENTRAL
    default y

endif

if SHIELD_ORCUS_LEFT || SHIELD_ORCUS_RIGHT

config ZMK_SPLIT
    default y

endif
```

## config/boards/shields/orcus/Kconfig.shield
```kconfig
# Copyright (c) 2022 The ZMK Contributors
# SPDX-License-Identifier: MIT

config SHIELD_ORCUS_LEFT
    def_bool $(shields_list_contains,orcus_left)

config SHIELD_ORCUS_RIGHT
    def_bool $(shields_list_contains,orcus_right)
```

## config/west.yml
```yaml
manifest:
  remotes:
    - name: zmkfirmware
      url-base: https://github.com/zmkfirmware
  projects:
    - name: zmk
      remote: zmkfirmware
      revision: main
      import: app/west.yml
    - name: zmk-module-layer-underglow-macro
      remote: zmkfirmware
      revision: main
      path: modules/zmk-layer-underglow-macro
  self:
    path: config
```
